## components/esp_new_jpeg/Kconfig
```kconfig
menu "JPEG Encoder"

config JPEG_ENC_ENABLE_TASK
    bool "Enable internal JPEG encoder task"
    default y
    help
        If enabled, jpeg_enc_process() will run the encoder in a background task.

endmenu
```

## sdkconfig.defaults
```kconfig
CONFIG_JPEG_ENC_ENABLE_TASK=y
CONFIG_ESP_MAIN_TASK_STACK_SIZE=4096
CONFIG_FREERTOS_UNICORE=n
CONFIG_ESP_SYSTEM_MEMPROT_FEATURE=n
```
